/* Copyright (c) 2013-2014, The Linux Foundation. All rights reserved.
 *
 * This program is free software; you can redistribute it and/or modify
 * it under the terms of the GNU General Public License version 2 and
 * only version 2 as published by the Free Software Foundation.
 *
 * This program is distributed in the hope that it will be useful,
 * but WITHOUT ANY WARRANTY; without even the implied warranty of
 * MERCHANTABILITY or FITNESS FOR A PARTICULAR PURPOSE.  See the
 * GNU General Public License for more details.
 */
#include "sharp-pinctrl-nfc.dtsi"
#include "sharp-pinctrl-shub.dtsi"
#include "sharp-pinctrl-audio.dtsi"

#include "sharp-pinctrl-pa29-sdcc.dtsi"
#include "dtv_pinctrl_pa29.dtsi"
#include "sharp-pinctrl-prox.dtsi"
#include "sharp-pinctrl-pa29-shdisp.dtsi"
