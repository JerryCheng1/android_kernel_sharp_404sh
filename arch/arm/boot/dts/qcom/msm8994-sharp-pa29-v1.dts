/* Copyright (c) 2014, The Linux Foundation. All rights reserved.
 *
 * This program is free software; you can redistribute it and/or modify
 * it under the terms of the GNU General Public License version 2 and
 * only version 2 as published by the Free Software Foundation.
 *
 * This program is distributed in the hope that it will be useful,
 * but WITHOUT ANY WARRANTY; without even the implied warranty of
 * MERCHANTABILITY or FITNESS FOR A PARTICULAR PURPOSE.  See the
 * GNU General Public License for more details.
 */


/dts-v1/;

#include "msm8994-v1.dtsi"
#include "msm8994-pinctrl.dtsi"
#include "sharp-common.dtsi"
#include "sharp-pa29.dtsi"

/ {
	model = "sharp pa29, Inc. MSM8994 CDP";
	compatible = "qcom,sharp-pa29", "qcom,msm8994", "qcom,cdp";
	qcom,board-id = <99 0>;
};
