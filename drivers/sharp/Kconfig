## drivers/sharp/Kconfig
```kconfig
#
# SHARP configuration
#

menu "SHARP Device Drivers"

source "drivers/sharp/shdiag/Kconfig"
source "drivers/sharp/shbatt/Kconfig"
#/* SH_AUDIO_DRIVER -> */ /*14-002*/
source "drivers/sharp/shaudio/Kconfig"
#/* SH_AUDIO_DRIVER <- */ /*14-002*/

#source "drivers/sharp/tunerdrv/Kconfig"
source "drivers/sharp/tunerdrv_tmm/Kconfig"

source "drivers/sharp/shtps/Kconfig"
source "drivers/sharp/nfc/Kconfig"
# SH_BOOT_CUST start
source "drivers/sharp/shboot/Kconfig"
# SH_BOOT_CUST end
source "drivers/sharp/proximity/Kconfig"
source "drivers/sharp/shsensor_hub/ml630q790/Kconfig"
source "drivers/sharp/shlog/Kconfig"
source "drivers/sharp/shgrip/Kconfig"
source "drivers/sharp/shdisp/Kconfig"
source "drivers/sharp/shdisp_lcdc/Kconfig"
source "drivers/sharp/shterm/Kconfig"
source "drivers/sharp/wifi/Kconfig"
source "drivers/sharp/vold/Kconfig"
source "drivers/sharp/shfpsensor/Kconfig"
source "drivers/sharp/shcamled/Kconfig"
source "drivers/sharp/shirda/Kconfig"
source "drivers/sharp/shtimer/Kconfig"
source "drivers/sharp/shflip/Kconfig"

endmenu
```

## drivers/sharp/shfpsensor/Kconfig
```kconfig
#
# Sensor  drivers configuration
#
menuconfig SENSORS_FINGERPRINT
	bool "Finger Print Sensor devices"
	help
	  Say Y here, and a list of sensors drivers will be displayed.
	  Everything that didn't fit into the other categories is here. This option
	  doesn't affect the kernel.

	  If unsure, say Y.

if SENSORS_FINGERPRINT
config SENSORS_FPRINT_SYSFS
	tristate "fingerprint sensor sysfs support"
	default n
	help
	  If you say yes here you get support for
	  fingerprint sensor FINGERPRINT_SYSFS

config SENSORS_FPRINT_VFS61XX
	tristate "VFS61xx fingerprint sensor support"
	default n
	help
	  If you say yes here you get support for Validity's
	  fingerprint sensor VFS61xx.

config SENSORS_FPRINT_SECURE
	tristate "VFS6100 fingerprint sensor support"
	default n
	help
	  If you say yes here you get support for Validity's
	  fingerprint sensor enable secure zone.

config SENSORS_FPRINT_PINCTRL
	tristate "fingerprint sensor pinctrl support"
	default n
	help
	  If you say yes here you get support for
	  fingerprint sensor pinctrl.

config SENSORS_FPRINT_SPICLK
	tristate "fingerprint sensor support of SPI clock control"
	default n
	help
	  If you say yes here you get support for
	  fingerprint sensor SPI clock control.

config SENSORS_FPRINT_WAIT_PWRCTRL
	tristate "fingerprint sensor support of wait after power control"
	default n
	help
	  If you say yes here you get support for
	  fingerprint sensor wait after power control.

config SENSORS_FPRINT_ORIENTATION_REVERSE
	tristate "fingerprint sensor orientation is reverse"
	default n
	help
	  If you say yes here you get support for
	  fingerprint sensor orientation is reverse.
endif
```

## drivers/sharp/shlog/Kconfig
```kconfig
# drivers/sharp/shlog/Kconfig

menu "SHLOG_SYSTEM"

comment "SHLOG_SYSTEM"

config SHLOG_SYSTEM
bool "SHLOG_SYSTEM driver"
default y

config SHLOG_SYSTEM_LOGCAT
bool "enable SHLOG_SYSTEM logcat"
depends on SHLOG_SYSTEM
default n

endmenu
```

## drivers/sharp/shtps/sy3000/Kconfig
```kconfig
#
# Sharp Touchscreen configuration
#

if TOUCHSCREEN_SHTPS

	config SHTPS_SY3X00_DEV
		tristate "SY3x00 Device"
		default n
		depends on TOUCHSCREEN_SHTPS

	config SHTPS_SY3000_TM3097_001
		tristate "SY3000 TM3097-001"
		default n
		depends on SHTPS_SY3X00_DEV

	config SHTPS_SY3000_PLG475_001
		tristate "SY3000 PLG475-001"
		default n
		depends on SHTPS_SY3X00_DEV

	config SHTPS_SY3000_PLG485_001
		tristate "SY3000 PLG485-001"
		default n
		depends on SHTPS_SY3X00_DEV

	config SHTPS_SY3000_PLG480_001
		tristate "SY3000 PLG480-001"
		default n
		depends on SHTPS_SY3X00_DEV

endif # TOUCHSCREEN_SHTPS
```
